## drivers/noc/n100/Kconfig
```kconfig
#
# For a description of the syntax of this configuration file,
# see scripts/kbuild/config-language.txt.
#

config ARCH_HAS_N100
	bool
	select ARCH_HAS_CMN600

menuconfig N100
	bool "SpacemiT N100 support"
	depends ARCH_HAS_N100
	select CMN600

if N100

config ARCH_HAS_N100_CCIX
	bool
	select ARCH_HAS_CMN600_CML

config N100_CCIX
	bool "Enable Coherent Multichip Link (CML) support"
	depends ARCH_HAS_CMN600_CML
	select BIT_FLS64
	select CMN600_CML

if N100_CCIX

endif

config N100_DEBUG
	bool "Enable register debugging"
	depends CONSOLE_DEBUG
	select CMN600_DEBUG

endif
```
